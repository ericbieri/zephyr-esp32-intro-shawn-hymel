## apps/01_blink/build/Kconfig/boards/Kconfig
```kconfig
# Load Zephyr board Kconfig descriptions.
osource "/opt/toolchains/zephyr/boards/espressif/esp32c6_devkitc/Kconfig"
```

## apps/01_blink/build/Kconfig/boards/Kconfig.defconfig
```kconfig
# Load Zephyr board defconfig descriptions.
osource "/opt/toolchains/zephyr/boards/espressif/esp32c6_devkitc/Kconfig.defconfig"
```

## apps/01_blink/build/Kconfig/boards/Kconfig.esp32c6_devkitc
```kconfig
# Load board Kconfig descriptions.
osource "/opt/toolchains/zephyr/boards/espressif/esp32c6_devkitc/Kconfig.esp32c6_devkitc"
```

## apps/01_blink/build/Kconfig/boards/Kconfig.sysbuild
```kconfig
# Load Sysbuild board Kconfig descriptions.
osource "/opt/toolchains/zephyr/boards/espressif/esp32c6_devkitc/Kconfig.sysbuild"
```
